/* WS2812B camp indicator chain, bit-banged on LED_DIN (PA5).
 *
 * TIM2 belongs to the period-capture path, so the 800 kHz stream is
 * generated by cycle-exact busy loops on DWT->CYCCNT at 170 MHz, with
 * interrupts masked for the ~240 us frame. Noise gating is structural:
 * the firmware is a single loop, measure_square() runs to completion,
 * so a frame can only ever go out between measurements, never during
 * one (ADR 0009).
 *
 * Chain order and camp colors come from board_pins.h, generated from
 * config/board.yaml.
 */

#include "app.h"

#define T_BIT_CYC 213u   /* 1.25 us */
#define T1H_CYC 136u     /* 0.80 us */
#define T0H_CYC 68u      /* 0.40 us */

static const uint8_t chain_sq[LED_COUNT] = LED_CHAIN_SQ;
static uint32_t grb[LED_COUNT];

static uint32_t pack_grb(uint32_t rgb) {
    uint32_t r = (rgb >> 16) & 0xFFu;
    uint32_t g = (rgb >> 8) & 0xFFu;
    uint32_t b = rgb & 0xFFu;
    return (g << 16) | (r << 8) | b;
}

void led_init(void) {
    gpio_out(LED_DIN_PORT, LED_DIN_PIN);
    gpio_clear(LED_DIN_PORT, LED_DIN_PIN);
    for (uint32_t i = 0; i < LED_COUNT; i++) {
        grb[i] = 0u;
    }
}

void led_set_square(uint32_t square, led_camp_t camp) {
    uint32_t rgb = 0u;
    if (camp == LED_CAMP_WHITE) {
        rgb = LED_COLOR_WHITE;
    } else if (camp == LED_CAMP_BLACK) {
        rgb = LED_COLOR_BLACK;
    }
    for (uint32_t i = 0; i < LED_COUNT; i++) {
        if (chain_sq[i] == square) {
            grb[i] = pack_grb(rgb);
        }
    }
}

void led_apply(void) {
    __disable_irq();
    uint32_t t = DWT->CYCCNT;
    for (uint32_t i = 0; i < LED_COUNT; i++) {
        uint32_t v = grb[i];
        for (int bit = 23; bit >= 0; bit--) {
            uint32_t high = (v & (1u << bit)) ? T1H_CYC : T0H_CYC;
            gpio_set(LED_DIN_PORT, LED_DIN_PIN);
            while ((DWT->CYCCNT - t) < high) {
            }
            gpio_clear(LED_DIN_PORT, LED_DIN_PIN);
            while ((DWT->CYCCNT - t) < T_BIT_CYC) {
            }
            t += T_BIT_CYC;
        }
    }
    __enable_irq();
    delay_ns(300000u);      /* latch, line held low */
}

void led_all_off(void) {
    for (uint32_t i = 0; i < LED_COUNT; i++) {
        grb[i] = 0u;
    }
    led_apply();
}
